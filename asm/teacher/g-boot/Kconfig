## asm/y-boot/Kconfig
```kconfig
menu "Drivers"
source "drivers/Kconfig"
endmenu

menu "Command"
source "cmd/Kconfig"
endmenu
```

## asm/y-boot/cmd/Kconfig
```kconfig
config ECHO
bool "enable command echo"

config NAND
bool "enable command nand"

config BOOTM

bool "enable command bootm"

config AUDIO
bool "enable command audio"
```
